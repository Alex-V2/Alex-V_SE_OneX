## arch/arm/mach-tegra/Kconfig.rej
```kconfig
--- arch/arm/mach-tegra/Kconfig
+++ arch/arm/mach-tegra/Kconfig
@@ -845,6 +845,12 @@
 	help
 	  Support for SENSE 4 PLUS.
 
+config BUILD_FOR_SENSE
+	depends on ARCH_TEGRA_3x_SOC
+	bool "Enable special things for Sense ROMs"
+	help
+	  This will make the kernel more compatible with Sense based ROMs.
+
 config MEMORY_FOOTPRINT_DEBUGGING
 	bool "footprint for debugging"
 	default n
```

## block/Kconfig.iosched.rej
```kconfig
--- block/Kconfig.iosched
+++ block/Kconfig.iosched
@@ -74,6 +84,7 @@
 config DEFAULT_IOSCHED
 	string
 	default "deadline" if DEFAULT_DEADLINE
+	default "vr" if DEFAULT_VR
 	default "cfq" if DEFAULT_CFQ
 	default "noop" if DEFAULT_NOOP
 
```
